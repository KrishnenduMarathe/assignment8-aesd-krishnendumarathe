## base_external/package/ldd/Config.in
```kconfig
config BR2_PACKAGE_LDD
		bool "ldd"
		depends on BR2_LINUX_KERNEL
		help
			Includes the scull linux driver implementation from assignment 7.
			Used to understand linux drivers within buildroot.
```
